#include "display.h"
#include "config.h"
#include "epd_backend.h"
#include "debug_trace.h"
#include <esp_heap_caps.h>
#include <soc/soc_memory_types.h>
// Reader fonts — three families × five sizes, all OFL-licensed, generated by
// tools/build_fonts.sh from upstream variable-font sources.
//   Sans   = Lexend Deca (research-backed reading sans)
//   Serif  = Literata    (Google's e-reader serif)
//   Slab   = Bitter      (slab serif tuned for e-ink contrast)
// Sizes match the previous 5-level UI: XS(9pt) S(11pt) M(14pt) ML(17pt) L(20pt).
#include "font_lexend_xs.h"
#include "font_lexend_s.h"
#include "font_lexend_m.h"
#include "font_lexend_ml.h"
#include "font_lexend_l.h"
#include "font_literata_xs.h"
#include "font_literata_s.h"
#include "font_literata_m.h"
#include "font_literata_ml.h"
#include "font_literata_l.h"
#include "font_bitter_xs.h"
#include "font_bitter_s.h"
#include "font_bitter_m.h"
#include "font_bitter_ml.h"
#include "font_bitter_l.h"
// UI font — Inter (Google Fonts, OFL).  Used for all chrome: header,
// footer, menus, settings, library list.  Kept separate from the reader
// family selection so changing the reader font never affects UI legibility.
#include "font_inter_xs.h"
#include "font_inter_s.h"
#include "font_inter_m.h"
#include "font_inter_ml.h"
#include "font_inter_l.h"
// ChareInk7SP — derivative of SIL Charis (OFL 1.1) re-tuned for e-ink.
// Generated once via tools/fontconvert.py from the Regular face of the
// CrossInk-derived ChareInk7SP TTF; only the regular weight is shipped.
// The reader pipeline does not render italic/bold at runtime, so the
// remaining variants in the upstream archive are intentionally unused.
#include "font_chareink_xs.h"
#include "font_chareink_s.h"
#include "font_chareink_m.h"
#include "font_chareink_ml.h"
#include "font_chareink_l.h"
#include "miniz.h"
// EPD whine mitigation: the epdiy I2S bus clock can produce an audible
// whine.  Aggressive approaches (clock-gating I2S1, driving CKH/CKV LOW)
// caused device lockups because those pins are shared with boot strapping.
// For now, we rely on epd_be_poweroff() which disables the high-voltage
// converters.  The residual I2S clock whine is a known hardware limitation
// of the T5S3 PRO board.

// Portrait framebuffer: 540 wide × 960 tall, 4bpp packed
static uint8_t* _pfb = nullptr;
// Landscape framebuffer for pushing to hardware: 960 wide × 540 tall
static uint8_t* _lfb = nullptr;

// Compile-time guard: if a new FontFamily value is added to the enum
// without bumping FONT_FAMILY_COUNT, the table row count below will be
// wrong and an `int family` value can index past the end.  These asserts
// catch that at build time instead of in production.
static_assert(FONT_FAMILY_CHAREINK + 1 == FONT_FAMILY_COUNT,
              "FontFamily enum out of sync with FONT_FAMILY_COUNT — bump config.h");

// FONT_SIZE_LEVEL_COUNT × FONT_FAMILY_COUNT lookup.  Outer index =
// FontFamily enum, inner index = fontSizeLevel (0=XS .. 4=L).  Row order
// must match the enum in display.h so a family value can index directly
// without a runtime switch.
static const GFXfont* _font_table[FONT_FAMILY_COUNT][FONT_SIZE_LEVEL_COUNT] = {
    // FONT_FAMILY_SANS — Lexend Deca
    { &LexendXS,   &LexendS,   &LexendM,   &LexendML,   &LexendL   },
    // FONT_FAMILY_SERIF — Literata
    { &LiterataXS, &LiterataS, &LiterataM, &LiterataML, &LiterataL },
    // FONT_FAMILY_SLAB — Bitter
    { &BitterXS,   &BitterS,   &BitterM,   &BitterML,   &BitterL   },
    // FONT_FAMILY_INTER — Inter (also the UI font)
    { &InterXS,    &InterS,    &InterM,    &InterML,    &InterL    },
    // FONT_FAMILY_CHAREINK — ChareInk7SP (SIL Charis derivative for e-ink)
    { &ChareInkXS, &ChareInkS, &ChareInkM, &ChareInkML, &ChareInkL },
};

// Public display name table — declared in display.h so UI labels and serial
// logs share one source of truth.
const char* const kFontFamilyNames[FONT_FAMILY_COUNT] = {
    "Lexend (Sans)", "Literata (Serif)", "Bitter (Slab)", "Inter", "ChareInk",
};
static_assert(sizeof(_font_table) / sizeof(_font_table[0]) == FONT_FAMILY_COUNT,
              "_font_table row count must match FONT_FAMILY_COUNT");
static_assert(sizeof(kFontFamilyNames) / sizeof(kFontFamilyNames[0]) == FONT_FAMILY_COUNT,
              "kFontFamilyNames must have one entry per FontFamily");

// UI fonts — always Inter, indexed by the same 5-level size scale as the
// reader.  Kept as a flat array (not part of _font_table) because the UI
// family is fixed and not user-selectable.
static const GFXfont* _ui_fonts[FONT_SIZE_LEVEL_COUNT] = {
    &InterXS, &InterS, &InterM, &InterML, &InterL,
};
static_assert(sizeof(_ui_fonts) / sizeof(_ui_fonts[0]) == FONT_SIZE_LEVEL_COUNT,
              "_ui_fonts must have one entry per font size level");

static const GFXfont* _font = &InterM;  // boot default — UI font at level 2

// ─── Intent-based partial-update state ────────────────────────────────
// Zone dirty-tracking table — see Zone enum in display.h. Reader zones
// tile the 540×960 portrait surface with at most a 16 px gap between
// header and body (the body starts at y=82 because the original layout
// reserved that strip for a separator / chrome spacer). Coordinates are
// portrait-space; rotatePortraitRegion() maps to landscape at draw time.
struct ZoneState {
    int x;
    int y;
    int w;
    int h;
    bool dirty;
    ChangeKind intent;
};

static ZoneState _zones[(int)Zone::_Count] = {
    /* ReaderHeader */ {   0,   0, 540,  66, false, ChangeKind::GlyphTick        },
    /* ReaderBody   */ {   0,  82, 540, 828, false, ChangeKind::TextReflow       },
    /* ReaderFooter */ {   0, 910, 540,  50, false, ChangeKind::TextReflow       },
    /* Overlay      */ {   0,   0,   0,   0, false, ChangeKind::StructuralRedraw },
    /* FullScreen   */ {   0,   0, 540, 960, false, ChangeKind::StructuralRedraw },
};

// Layout sanity: zone table must agree with config.h chrome dimensions and
// must tile the full 960 px portrait height (header + gap + body + footer).
static_assert(HEADER_HEIGHT == 66,
              "HEADER_HEIGHT changed — update Zone::ReaderHeader rect");
static_assert(FOOTER_HEIGHT == 50,
              "FOOTER_HEIGHT changed — update Zone::ReaderFooter rect");
static_assert(66 + 16 + 828 + 50 == PORTRAIT_H,
              "Reader zones (header + gap + body + footer) must tile portrait height");
static_assert(PORTRAIT_W == 540,
              "Zone rects assume PORTRAIT_W == 540");
static_assert(PORTRAIT_H == 960,
              "Zone rects assume PORTRAIT_H == 960");

// Anti-ghost cadence: after this many consecutive partial frames, the next
// flush is auto-upgraded to a full GC16 refresh (and the counter resets).
// The threshold itself lives in include/config.h as REFRESH_INTERVAL_READER
// so it can be tuned without editing display code; 6 matches the documented
// reader page-turn budget for ED047TC1 + VCOM 2400 mV.
static int _framesSinceFullRefresh = 0;

// Power batching: _lastPoweroffMs is recorded on every flush poweroff so a
// future backend variant can implement a "hold rails warm" mode and skip
// the epd_be_poweron() ramp when the previous poweroff was < POWER_HOLD_
// WINDOW_MS ago.
//
// Currently not wired (epd_be_poweroff_all() drops rails fully); reserved
// for a future backend variant that supports "hold warm" between flushes.
// See WP-0.2 review notes.
[[maybe_unused]] static constexpr unsigned long POWER_HOLD_WINDOW_MS = 80;
static unsigned long _lastPoweroffMs = 0;

// Per-flush summary logging — one Serial line per real flush. Default
// off because Serial.printf at 115200 baud costs ~5 ms blocking per
// flush, which is real overhead during fast page-turning and OTA.
// Flip to 1 when characterizing waveform/mode behavior or anti-ghost
// cadence on the bench.
#ifndef DISPLAY_FLUSH_LOG
#define DISPLAY_FLUSH_LOG 0
#endif

// Per-flush verbose logging (one Serial line per dirty zone). Implies
// DISPLAY_FLUSH_LOG — the verbose lines have no context without the
// summary. Default off to keep the serial log readable on real-device
// tuning sessions; flip to 1 when characterizing per-zone waveforms.
#ifndef DISPLAY_FLUSH_VERBOSE_LOG
#define DISPLAY_FLUSH_VERBOSE_LOG 0
#endif

// Human-readable zone name for [FLUSH] log lines. Kept inside the .cpp so
// the header doesn't grow a debug helper. Index must match the Zone enum.
[[maybe_unused]] static const char* zone_name(Zone z) {
    switch (z) {
        case Zone::ReaderHeader: return "ReaderHeader";
        case Zone::ReaderBody:   return "ReaderBody";
        case Zone::ReaderFooter: return "ReaderFooter";
        case Zone::Overlay:      return "Overlay";
        case Zone::FullScreen:   return "FullScreen";
        case Zone::_Count:       return "?";
    }
    return "?";
}

// epdiy EpdDrawMode integer values, hardcoded here because including
// <epdiy.h> in display.cpp would collide with our extern-C EpdRect
// typedef. Values match the enum in .pio/libdeps/default/epdiy/src/epdiy.h
// and are stable across upstream releases (epdiy ≥ v2.0.0).
//   MODE_DU   = 0x1   (mono direct-update)
//   MODE_GC16 = 0x2   (16-grey, flashing)
//   MODE_GL16 = 0x5   (16-grey, non-flashing)
//   MODE_DU4  = 0x7   (4-grey direct-update)
[[maybe_unused]] static constexpr int EPD_MODE_DU   = 0x1;
static constexpr int EPD_MODE_GC16 = 0x2;
static constexpr int EPD_MODE_GL16 = 0x5;
static constexpr int EPD_MODE_DU4  = 0x7;

// ─── Glyph Bitmap LRU Cache (PSRAM) ──────────────────────────────────────

static const int GLYPH_CACHE_SIZE = 16;  // number of cached glyphs
static const int GLYPH_CACHE_MAX_BMP = 512; // max bitmap bytes per entry

struct GlyphCacheEntry {
    const GFXfont* font;    // which font (acts as font_id)
    uint32_t codepoint;     // glyph codepoint
    uint8_t bitmap[GLYPH_CACHE_MAX_BMP]; // decompressed bitmap
    uint16_t bmpSize;       // actual bitmap size
    uint32_t lastUsed;      // access counter for LRU
    bool valid;
};

static GlyphCacheEntry _glyphCache[GLYPH_CACHE_SIZE];
static uint32_t _glyphCacheAccessCounter = 0;

static void glyph_cache_init() {
    for (int i = 0; i < GLYPH_CACHE_SIZE; i++) {
        _glyphCache[i].valid = false;
        _glyphCache[i].lastUsed = 0;
    }
    _glyphCacheAccessCounter = 0;
}

// Find cached bitmap or return nullptr
static uint8_t* glyph_cache_find(const GFXfont* font, uint32_t cp) {
    for (int i = 0; i < GLYPH_CACHE_SIZE; i++) {
        if (_glyphCache[i].valid && _glyphCache[i].font == font && _glyphCache[i].codepoint == cp) {
            _glyphCache[i].lastUsed = ++_glyphCacheAccessCounter;
            return _glyphCache[i].bitmap;
        }
    }
    return nullptr;
}

// Store decompressed bitmap in cache, evicting LRU entry if needed
static uint8_t* glyph_cache_store(const GFXfont* font, uint32_t cp, const uint8_t* bmp, uint16_t size) {
    if (size > GLYPH_CACHE_MAX_BMP) return nullptr; // too large to cache

    // Find empty slot or LRU slot
    int slot = -1;
    uint32_t oldest = UINT32_MAX;
    for (int i = 0; i < GLYPH_CACHE_SIZE; i++) {
        if (!_glyphCache[i].valid) {
            slot = i;
            break;
        }
        if (_glyphCache[i].lastUsed < oldest) {
            oldest = _glyphCache[i].lastUsed;
            slot = i;
        }
    }
    if (slot < 0) slot = 0; // safety

    _glyphCache[slot].font = font;
    _glyphCache[slot].codepoint = cp;
    memcpy(_glyphCache[slot].bitmap, bmp, size);
    _glyphCache[slot].bmpSize = size;
    _glyphCache[slot].lastUsed = ++_glyphCacheAccessCounter;
    _glyphCache[slot].valid = true;

    return _glyphCache[slot].bitmap;
}

// ─── Portrait framebuffer pixel ops ────────────────────────────────

static inline void pset(int x, int y, uint8_t g4) {
    if ((unsigned)x >= PORTRAIT_W || (unsigned)y >= PORTRAIT_H) return;
    int idx = y * (PORTRAIT_W / 2) + x / 2;
    if (x & 1) _pfb[idx] = (_pfb[idx] & 0xF0) | (g4 & 0x0F);
    else        _pfb[idx] = (_pfb[idx] & 0x0F) | ((g4 & 0x0F) << 4);
}

static inline uint8_t pget(int x, int y) {
    if ((unsigned)x >= PORTRAIT_W || (unsigned)y >= PORTRAIT_H) return 15;
    int idx = y * (PORTRAIT_W / 2) + x / 2;
    return (x & 1) ? (_pfb[idx] & 0x0F) : ((_pfb[idx] >> 4) & 0x0F);
}

// ─── UTF-8 decoder ─────────────────────────────────────────────────

static uint32_t next_codepoint(const uint8_t** pp) {
    const uint8_t* p = *pp;
    if (*p == 0) return 0;
    uint32_t cp;
    int bytes;
    if (*p < 0x80)        { cp = *p; bytes = 1; }
    else if (*p < 0xC0)   { cp = 0xFFFD; bytes = 1; }
    else if (*p < 0xE0)   { cp = *p & 0x1F; bytes = 2; }
    else if (*p < 0xF0)   { cp = *p & 0x0F; bytes = 3; }
    else                   { cp = *p & 0x07; bytes = 4; }
    for (int i = 1; i < bytes; i++) {
        if ((p[i] & 0xC0) != 0x80) { *pp = p + i; return 0xFFFD; }
        cp = (cp << 6) | (p[i] & 0x3F);
    }
    *pp = p + bytes;
    return cp;
}

// ─── Custom glyph renderer (portrait buffer) ──────────────────────

static void draw_glyph(int* cursor_x, int cursor_y, uint32_t cp, uint8_t fg) {
    GFXglyph* glyph = nullptr;
    get_glyph(_font, cp, &glyph);
    if (!glyph) return;

    uint8_t w = glyph->width;
    uint8_t h = glyph->height;
    int32_t left = glyph->left;
    int32_t byte_w = (w / 2 + w % 2);
    unsigned long bmp_size = byte_w * h;

    uint8_t* bitmap = nullptr;
    bool needsFree = false;

    if (_font->compressed) {
        // Check glyph cache first
        bitmap = glyph_cache_find(_font, cp);
        if (!bitmap) {
            // Cache miss — decompress
            uint8_t* tmpBuf = (uint8_t*)malloc(bmp_size);
            if (!tmpBuf) { *cursor_x += glyph->advance_x; return; }
            mz_ulong dest_len = bmp_size;
            if (mz_uncompress(tmpBuf, &dest_len,
                              &_font->bitmap[glyph->data_offset],
                              glyph->compressed_size) != MZ_OK) {
                free(tmpBuf);
                *cursor_x += glyph->advance_x;
                return;
            }
            // Try to store in cache
            uint8_t* cached = glyph_cache_store(_font, cp, tmpBuf, (uint16_t)bmp_size);
            if (cached) {
                free(tmpBuf);
                bitmap = cached;
            } else {
                // Too large for cache, use tmp and free later
                bitmap = tmpBuf;
                needsFree = true;
            }
        }
    } else {
        bitmap = &_font->bitmap[glyph->data_offset];
    }

    // Build color lookup: glyph value 0=bg(white), 15=full fg
    uint8_t lut[16];
    for (int c = 0; c < 16; c++) {
        int val = 15 + c * ((int)fg - 15) / 15;
        lut[c] = (uint8_t)(val < 0 ? 0 : (val > 15 ? 15 : val));
    }

    for (int gy = 0; gy < h; gy++) {
        int py = cursor_y - glyph->top + gy;
        if (py < 0 || py >= PORTRAIT_H) continue;
        for (int gx = 0; gx < w; gx++) {
            int px = *cursor_x + left + gx;
            if (px < 0 || px >= PORTRAIT_W) continue;
            uint8_t bm = bitmap[gy * byte_w + gx / 2];
            uint8_t val = (gx & 1) ? (bm >> 4) : (bm & 0x0F);
            if (val > 0) pset(px, py, lut[val]);
        }
    }

    if (needsFree) free(bitmap);
    *cursor_x += glyph->advance_x;
}

// ─── Public API ────────────────────────────────────────────────────

void display_init() {
    epd_be_init();
    epd_be_poweroff();
    // whine mitigation removed — see comment at top of file

    _pfb = (uint8_t*)ps_calloc(PORTRAIT_W * PORTRAIT_H / 2, 1);
    _lfb = (uint8_t*)ps_calloc(PHYS_WIDTH * PHYS_HEIGHT / 2, 1);
    if (!_pfb || !_lfb) {
        // Fatal — every drawing call below is a no-op while _pfb is null,
        // and the panel would silently stay blank forever. Halt loudly so
        // the serial log shows the cause and the watchdog eventually
        // reboots into a (hopefully) cleaner heap state.
        Serial.println("FATAL: framebuffer alloc failed (PSRAM exhausted)");
        Serial.flush();
        while (true) {
            delay(1000);
        }
    }
    memset(_pfb, 0xFF, PORTRAIT_W * PORTRAIT_H / 2);
    memset(_lfb, 0xFF, PHYS_WIDTH * PHYS_HEIGHT / 2);

    glyph_cache_init();
}

void display_clear() {
    memset(_pfb, 0xFF, PORTRAIT_W * PORTRAIT_H / 2);

    epd_be_poweron();
    epd_be_clear();
    epd_be_poweroff_all();
    _lastPoweroffMs = millis();
    // Panel is now physically white; reset anti-ghost counter so the
    // next frame doesn't immediately escalate to a forced full refresh.
    _framesSinceFullRefresh = 0;
}

void display_fill_screen(uint8_t gray4) {
    debug_trace_mark("display_fill_screen:start",
                     String((uint32_t)(uintptr_t)_pfb, HEX));
    if (!_pfb) {
        debug_trace_mark("display_fill_screen:null_pfb");
        return;
    }
    if (!esp_ptr_external_ram(_pfb)) {
        debug_trace_mark("display_fill_screen:pfb_not_psram",
                         String((uint32_t)(uintptr_t)_pfb, HEX));
    }
    if (!heap_caps_check_integrity_addr((intptr_t)_pfb, true)) {
        debug_trace_mark("display_fill_screen:pfb_corrupt",
                         String((uint32_t)(uintptr_t)_pfb, HEX));
        return;
    }

    uint8_t byte = (gray4 & 0x0F) | ((gray4 & 0x0F) << 4);
    memset(_pfb, byte, PORTRAIT_W * PORTRAIT_H / 2);
    debug_trace_mark("display_fill_screen:done");
}

void display_draw_text(int x, int y, const char* text, uint8_t fg_color) {
    if (!_pfb || !text) return;
    const uint8_t* p = (const uint8_t*)text;
    int cx = x;
    uint32_t cp;
    while ((cp = next_codepoint(&p)) != 0) {
        draw_glyph(&cx, y, cp, fg_color);
    }
}

void display_draw_pixel(int x, int y, uint8_t gray4) {
    if (!_pfb) return;
    pset(x, y, gray4);
}

void display_draw_filled_rect(int x, int y, int w, int h, uint8_t gray4) {
    if (!_pfb) return;
    int x0 = max(0, x), y0 = max(0, y);
    int x1 = min(PORTRAIT_W, x + w), y1 = min(PORTRAIT_H, y + h);
    if (x0 >= x1 || y0 >= y1) return;

    // Pack two nibbles per byte and memset the byte-aligned middle of each
    // row instead of pset()-ing every pixel. For a full-screen 540×960 fill
    // this collapses 518400 pset calls to ~960 short edge-fixups + a memset
    // per row — roughly two orders of magnitude faster.
    const int rowStride = PORTRAIT_W / 2;
    const uint8_t both = (uint8_t)(((gray4 & 0x0F) << 4) | (gray4 & 0x0F));

    for (int py = y0; py < y1; py++) {
        // Left edge: handle odd-aligned start pixel
        int px = x0;
        if (px & 1) {
            pset(px, py, gray4);
            px++;
        }
        // Middle: byte-aligned span
        int byteStart = px / 2;
        int byteEnd   = (x1 / 2);   // exclusive
        if (byteEnd > byteStart) {
            memset(&_pfb[py * rowStride + byteStart], both, byteEnd - byteStart);
        }
        // Right edge: handle trailing odd pixel
        if (x1 & 1) {
            pset(x1 - 1, py, gray4);
        }
    }
}

void display_draw_hline(int x, int y, int w, uint8_t gray4) {
    if (!_pfb || y < 0 || y >= PORTRAIT_H) return;
    int x0 = max(0, x), x1 = min(PORTRAIT_W, x + w);
    for (int px = x0; px < x1; px++) pset(px, y, gray4);
}

void display_draw_vline(int x, int y, int h, uint8_t gray4) {
    if (!_pfb || x < 0 || x >= PORTRAIT_W) return;
    int y0 = max(0, y), y1 = min(PORTRAIT_H, y + h);
    for (int py = y0; py < y1; py++) pset(x, py, gray4);
}

void display_draw_rect(int x, int y, int w, int h, uint8_t gray4) {
    if (w <= 0 || h <= 0) return;
    display_draw_hline(x, y, w, gray4);
    display_draw_hline(x, y + h - 1, w, gray4);
    display_draw_vline(x, y, h, gray4);
    display_draw_vline(x + w - 1, y, h, gray4);
}

// ─── Optimized rotation ─────────────────────────────────────────────
// Process portrait framebuffer in column-major order.
// Each portrait column (fixed px, varying py) maps to a landscape row
// at ly = (PW-1) - px, with lx = py.
// Process two portrait pixels at a time where possible.

static void rotatePortraitToLandscape() {
    const int pw = PORTRAIT_W;
    const int ph = PORTRAIT_H;
    const int p_stride = pw / 2;       // bytes per portrait row
    const int l_stride = PHYS_WIDTH / 2; // bytes per landscape row

    memset(_lfb, 0xFF, PHYS_WIDTH * PHYS_HEIGHT / 2);

    for (int px = 0; px < pw; px++) {
        int ly = (pw - 1) - px;
        uint8_t* lrow = _lfb + ly * l_stride;

        // Portrait column px: read from _pfb[py * p_stride + px/2]
        int p_byte_col = px / 2;
        bool px_odd = px & 1;

        for (int py = 0; py < ph; py++) {
            uint8_t pbyte = _pfb[py * p_stride + p_byte_col];
            uint8_t val = px_odd ? (pbyte & 0x0F) : ((pbyte >> 4) & 0x0F);

            // lx = py — epdiy expects even pixels in LOW nibble, odd in HIGH
            int lx = py;
            int l_byte = lx / 2;
            if (lx & 1) {
                lrow[l_byte] = (lrow[l_byte] & 0x0F) | ((val & 0x0F) << 4);
            } else {
                lrow[l_byte] = (lrow[l_byte] & 0xF0) | (val & 0x0F);
            }
        }
    }
}

// Sleep refresh: preserve the panel's normal post-refresh hold state so the
// sleep image remains latched correctly while the MCU enters deep sleep.
// Intentionally NOT routed through the new intent API — sleep image draw
// is a one-shot terminal operation that does its own clean clear+GC16 and
// must not interact with the partial-update counter.
void display_update_sleep() {
    if (!_pfb || !_lfb) return;

    unsigned long t0 = millis();
    rotatePortraitToLandscape();
    unsigned long t1 = millis();
    Serial.printf("Sleep rotation: %lums\n", t1 - t0);

    epd_be_poweron();
    epd_be_clear_area_cycles(epd_be_full_screen(), 6, 50);
    epd_be_draw_grayscale_image(epd_be_full_screen(), _lfb);
    epd_be_poweroff_all();  // zero all control bits for clean power state
    _lastPoweroffMs = millis();
    _framesSinceFullRefresh = 0;
}

// ─── Legacy shims onto the new intent API ─────────────────────────────
// These keep existing UI callers (ui_reader, ui_library, ui_settings, …)
// working unchanged. WP-1+ will migrate call sites to explicit
// display_mark_dirty(Zone, ChangeKind) so the right waveform is chosen
// per surface.
//
// Each shim is marked [[deprecated]] in display.h so remaining call
// sites show a build warning. The definitions below intentionally
// suppress that warning locally — only call sites should warn, not the
// implementations themselves.
#pragma GCC diagnostic push
#pragma GCC diagnostic ignored "-Wdeprecated-declarations"

void display_update() {
    // Wake-from-sleep / heavy clean: forces a GC16 full refresh with
    // 6-cycle clear and resets the anti-ghost counter.
    display_begin_frame();
    display_mark_dirty(Zone::FullScreen, ChangeKind::WakeFull);
    display_flush();
}

void display_update_medium() {
    // Legacy "medium" callers (chapter jump, settings exit) expect a
    // flashing full refresh — route through WakeFull so display_flush()
    // takes the full-clear path.
    display_begin_frame();
    display_mark_dirty(Zone::FullScreen, ChangeKind::WakeFull);
    display_flush();
}

void display_update_fast() {
    // Single-cycle "fast" full-screen update — now a GL16 non-flashing
    // partial covering the entire screen. The anti-ghost auto-upgrade
    // inside display_flush() will promote to a clean GC16 every
    // REFRESH_INTERVAL_READER frames.
    display_begin_frame();
    display_mark_dirty(Zone::FullScreen, ChangeKind::StructuralRedraw);
    display_flush();
}

// Rotate only a sub-region of the portrait framebuffer to landscape.
// Returns a freshly allocated buffer sized to the landscape sub-region.
// The caller must free() the returned buffer.
static uint8_t* rotatePortraitRegion(int px, int py, int pw, int ph, EpdRect& outArea) {
    // Clamp to portrait bounds
    if (px < 0) { pw += px; px = 0; }
    if (py < 0) { ph += py; py = 0; }
    if (px + pw > PORTRAIT_W) pw = PORTRAIT_W - px;
    if (py + ph > PORTRAIT_H) ph = PORTRAIT_H - py;
    if (pw <= 0 || ph <= 0) return nullptr;

    // Landscape coords: lx = py..py+ph-1, ly = (PW-1)-(px+pw-1)..(PW-1)-px
    outArea.x = py;
    outArea.y = (PORTRAIT_W - 1) - (px + pw - 1);
    outArea.width = ph;
    outArea.height = pw;

    int l_stride = (outArea.width + 1) / 2;  // bytes per row in output
    size_t outBytes = (size_t)l_stride * outArea.height;
    uint8_t* out = (uint8_t*)malloc(outBytes);
    if (!out) return nullptr;
    memset(out, 0xFF, outBytes);

    int p_stride = PORTRAIT_W / 2;  // bytes per portrait row

    for (int col = px; col < px + pw; col++) {
        // Portrait column 'col' maps to landscape row ly = (PW-1) - col
        int ly = (PORTRAIT_W - 1) - col;
        int outRow = ly - outArea.y;  // row index within output buffer
        uint8_t* dstRow = out + outRow * l_stride;

        int p_byte_col = col / 2;
        bool col_odd = col & 1;

        for (int row = py; row < py + ph; row++) {
            // Read portrait pixel
            uint8_t pbyte = _pfb[row * p_stride + p_byte_col];
            uint8_t val = col_odd ? (pbyte & 0x0F) : ((pbyte >> 4) & 0x0F);

            // Landscape lx = row, offset within output = lx - outArea.x
            int outCol = row - outArea.x;
            int dstByte = outCol / 2;
            if (outCol & 1) {
                dstRow[dstByte] = (dstRow[dstByte] & 0x0F) | ((val & 0x0F) << 4);
            } else {
                dstRow[dstByte] = (dstRow[dstByte] & 0xF0) | (val & 0x0F);
            }
        }
    }

    return out;
}

void display_update_reader_body(int x, int y, int w, int h, bool strongCleanup) {
    if (!_pfb) return;
    // The (x, y, w, h) hint from the caller is currently ignored: WP-1+
    // will replace this entry point with explicit zone marking from the
    // reader. For now we map the request to Zone::ReaderBody (which
    // already has the correct rect baked into the zone table) and use
    // TextReflow intent (GL16, non-flashing). The strongCleanup flag is
    // honored by escalating to StructuralRedraw, which the anti-ghost
    // cadence will still upgrade to GC16 on schedule.
    (void)x; (void)y; (void)w; (void)h;
    display_begin_frame();
    display_mark_dirty(Zone::ReaderBody,
                       strongCleanup ? ChangeKind::StructuralRedraw
                                     : ChangeKind::TextReflow);
    display_flush();
}

// Partial update: legacy entry point that historically redrew the full
// screen without a clear. Now mapped to a TextReflow pass over the three
// reader zones (header + body + footer), which is what every caller
// actually needed.
void display_update_partial() {
    display_begin_frame();
    display_mark_dirty(Zone::ReaderHeader, ChangeKind::TextReflow);
    display_mark_dirty(Zone::ReaderBody,   ChangeKind::TextReflow);
    display_mark_dirty(Zone::ReaderFooter, ChangeKind::TextReflow);
    display_flush();
}

// Legacy smart-mode dispatch. fullRefresh==true forces a GC16 clean; the
// non-full path is now handled by display_flush()'s anti-ghost counter,
// so the old _partialCount-based threshold here is no longer needed.
void display_update_mode(bool fullRefresh) {
    if (fullRefresh) {
        display_update();
    } else {
        display_update_partial();
    }
}

#pragma GCC diagnostic pop

// ─── Intent-based partial-update core ─────────────────────────────────

// Strength ranking used by display_mark_dirty() to merge multiple marks
// on the same zone within a single frame. Higher rank wins.
static int changekind_rank(ChangeKind k) {
    switch (k) {
        case ChangeKind::WakeFull:         return 5;
        case ChangeKind::SleepImage:       return 5;
        case ChangeKind::AntiGhost:        return 4;
        case ChangeKind::StructuralRedraw: return 3;
        case ChangeKind::TextReflow:       return 2;
        case ChangeKind::GlyphTick:        return 1;
        case ChangeKind::HighlightToggle:  return 1;
    }
    return 0;
}

// Map ChangeKind → epdiy EpdDrawMode integer. Returns the raw int value
// of MODE_GC16 / MODE_GL16 / MODE_DU4 from <epdiy.h>; we hardcode the
// numeric values (see EPD_MODE_* constants near the top of this file) to
// avoid pulling <epdiy.h> into display.cpp, which would clash with our
// extern-C EpdRect typedef in epd_backend.h.
static int changekind_to_mode(ChangeKind k) {
    switch (k) {
        case ChangeKind::GlyphTick:        return EPD_MODE_DU4;
        case ChangeKind::HighlightToggle:  return EPD_MODE_DU4;
        case ChangeKind::TextReflow:       return EPD_MODE_GL16;
        case ChangeKind::StructuralRedraw: return EPD_MODE_GL16;
        case ChangeKind::WakeFull:         return EPD_MODE_GC16;
        case ChangeKind::SleepImage:       return EPD_MODE_GC16;
        case ChangeKind::AntiGhost:        return EPD_MODE_GC16;
    }
    return EPD_MODE_GL16;
}

void display_begin_frame() {
    for (int i = 0; i < (int)Zone::_Count; i++) {
        _zones[i].dirty = false;
        // Reset intent to a neutral default; mark_dirty will set the
        // intent for any zone that actually changes this frame.
        _zones[i].intent = ChangeKind::TextReflow;
    }
}

void display_set_overlay_rect(int x, int y, int w, int h) {
    if (x < 0) { w += x; x = 0; }
    if (y < 0) { h += y; y = 0; }
    if (x + w > PORTRAIT_W) w = PORTRAIT_W - x;
    if (y + h > PORTRAIT_H) h = PORTRAIT_H - y;
    if (w < 0) w = 0;
    if (h < 0) h = 0;
    _zones[(int)Zone::Overlay].x = x;
    _zones[(int)Zone::Overlay].y = y;
    _zones[(int)Zone::Overlay].w = w;
    _zones[(int)Zone::Overlay].h = h;
}

void display_mark_dirty(Zone z, ChangeKind k) {
    const int idx = (int)z;
    if (idx < 0 || idx >= (int)Zone::_Count) return;
    if (!_zones[idx].dirty) {
        _zones[idx].dirty = true;
        _zones[idx].intent = k;
        return;
    }
    // Already dirty — keep whichever intent is stronger (e.g. a Text
    // Reflow added on top of a GlyphTick should escalate to GL16).
    if (changekind_rank(k) > changekind_rank(_zones[idx].intent)) {
        _zones[idx].intent = k;
    }
}

void display_force_full_refresh() {
    // Fire-and-forget. The display_begin_frame() below clears all zone
    // dirty flags, so callers MUST NOT pre-mark zones before calling
    // this — see the warning in display.h. If you need to flush an
    // already-marked frame through the full-clear path, mark at least
    // one zone with WakeFull and call display_flush() directly.
    //
    // Diagnostic entry check: warn if zones are already dirty on entry,
    // because the begin_frame() below would silently discard those marks
    // and the caller almost certainly intended for them to ship. This
    // helper is rare enough (only called from sleep-wake / hard refresh
    // paths) that an unconditional Serial.printf has negligible cost.
    for (int i = 0; i < (int)Zone::_Count; i++) {
        if (_zones[i].dirty) {
            Serial.printf("[FORCE] WARN: zone %s dirty on entry — pre-marks"
                          " will be discarded by begin_frame. Mark"
                          " WakeFull and call display_flush() directly"
                          " instead.\n",
                          zone_name((Zone)i));
            break;
        }
    }
    display_begin_frame();
    display_mark_dirty(Zone::FullScreen, ChangeKind::WakeFull);
    display_flush();
}

void display_flush() {
    if (!_pfb || !_lfb) return;

    // Pass 1: classify the frame.
    bool anyDirty = false;
    bool isFullRefresh = false;
    for (int i = 0; i < (int)Zone::_Count; i++) {
        if (!_zones[i].dirty) continue;
        anyDirty = true;
        const ChangeKind k = _zones[i].intent;
        if (k == ChangeKind::WakeFull ||
            k == ChangeKind::AntiGhost ||
            k == ChangeKind::SleepImage) {
            isFullRefresh = true;
        }
    }
    // No work to do — skip without logging. Keeps the serial line strictly
    // one-per-real-flush so it can be used as a hardware-side beat counter.
    if (!anyDirty) return;

    const unsigned long _flush_t0 = millis();

    // Anti-ghost auto-upgrade: if this frame would push us at or beyond
    // the threshold, escalate any dirty reader zone (and the FullScreen
    // zone, if dirty) to AntiGhost so the full-clear path runs.
    if (!isFullRefresh &&
        _framesSinceFullRefresh + 1 >= REFRESH_INTERVAL_READER) {
        for (int i = (int)Zone::ReaderHeader; i <= (int)Zone::ReaderFooter; i++) {
            if (_zones[i].dirty) _zones[i].intent = ChangeKind::AntiGhost;
        }
        if (_zones[(int)Zone::FullScreen].dirty) {
            _zones[(int)Zone::FullScreen].intent = ChangeKind::AntiGhost;
        }
        isFullRefresh = true;
    }

    // Read the temperature once per frame — cached at the backend, so a
    // single call covers every zone we push below.
    const int temp_c = epd_be_get_ambient_temp_cached();

    // Power batching is wired up via _lastPoweroffMs (recorded below
    // after epd_be_poweroff_all). The current backend (epd_be_poweroff_all
    // → epdiy epd_poweroff) fully drops the rails, so skipping the next
    // epd_be_poweron() is not yet safe. The hold window is reserved for
    // when the backend grows a lightweight "hold rails warm" variant.
    epd_be_poweron();

    if (isFullRefresh) {
        // Full-clear path: 6-cycle clear + GC16 GC redraw of the entire
        // panel, exactly mirroring the legacy display_update() behavior.
        // We render the whole portrait buffer into _lfb so that even if
        // only the FullScreen zone was marked dirty, the visible result
        // matches what's in the framebuffer.
        unsigned long t0 = millis();
        rotatePortraitToLandscape();
        unsigned long t1 = millis();
        Serial.printf("Flush rotation (full): %lums\n", t1 - t0);

        epd_be_clear_area_cycles(epd_be_full_screen(), 6, 50);
        epd_be_draw_grayscale_image(epd_be_full_screen(), _lfb,
                                    EPD_MODE_GC16, temp_c);
    } else {
        // Per-zone partial path. One epd_be_draw_grayscale_image call
        // per dirty zone, all batched between the single poweron/off
        // pair above. The FullScreen zone (used by the legacy fast/
        // partial shims) is handled with _lfb to avoid a 253 KB
        // malloc; sub-zones use rotatePortraitRegion()'s heap buffer.
        for (int i = 0; i < (int)Zone::_Count; i++) {
            if (!_zones[i].dirty) continue;
            ZoneState& z = _zones[i];
            if (z.w <= 0 || z.h <= 0) {
#if DISPLAY_FLUSH_LOG || DISPLAY_FLUSH_VERBOSE_LOG
                // Most common cause: Zone::Overlay was marked dirty but
                // the caller forgot display_set_overlay_rect() this frame
                // (the rect is reset to empty after every flush).
                if ((Zone)i == Zone::Overlay) {
                    Serial.printf("[FLUSH] WARN: Zone::Overlay dirty but rect empty"
                                  " — did you forget display_set_overlay_rect()?\n");
                }
#endif
                continue;
            }

            const int mode = changekind_to_mode(z.intent);

            if ((Zone)i == Zone::FullScreen) {
                // Whole-screen partial — use the PSRAM _lfb buffer.
                rotatePortraitToLandscape();
                epd_be_draw_grayscale_image(epd_be_full_screen(), _lfb,
                                            mode, temp_c);
                continue;
            }

            // Sub-zone — rotate just this rect into a heap buffer.
            EpdRect area;
            uint8_t* region = rotatePortraitRegion(z.x, z.y, z.w, z.h, area);
            if (!region || area.width <= 0 || area.height <= 0) {
                if (region) free(region);
                continue;
            }
            epd_be_draw_grayscale_image(area, region, mode, temp_c);
            free(region);
        }
    }

    epd_be_poweroff_all();
    _lastPoweroffMs = millis();

    // ─── Flush instrumentation ────────────────────────────────────────
    // One summary line per real flush. The counter logged below is the
    // pre-update value (how many partials had accumulated entering this
    // flush) so a "frames_since_full=6 full=1" line means "the 6-frame
    // anti-ghost backstop just fired". Gated behind DISPLAY_FLUSH_LOG
    // because Serial.printf at 115200 baud is ~5 ms blocking per flush.
#if DISPLAY_FLUSH_LOG || DISPLAY_FLUSH_VERBOSE_LOG
    int _flush_dirty = 0;
    for (int i = 0; i < (int)Zone::_Count; i++) {
        if (_zones[i].dirty) _flush_dirty++;
    }
    const unsigned long _flush_t1 = millis();
    Serial.printf("[FLUSH] zones=%d full=%d frames_since_full=%d ms=%lu\n",
                  _flush_dirty,
                  isFullRefresh ? 1 : 0,
                  _framesSinceFullRefresh,
                  _flush_t1 - _flush_t0);
#else
    (void)_flush_t0;
#endif
#if DISPLAY_FLUSH_VERBOSE_LOG
    for (int i = 0; i < (int)Zone::_Count; i++) {
        if (!_zones[i].dirty) continue;
        const ZoneState& z = _zones[i];
        Serial.printf("  zone=%s mode=%d rect=(%d,%d,%d,%d)\n",
                      zone_name((Zone)i),
                      changekind_to_mode(z.intent),
                      z.x, z.y, z.w, z.h);
    }
#endif

    // Counter management — update exactly once per frame, at the end.
    if (isFullRefresh) {
        _framesSinceFullRefresh = 0;
    } else {
        _framesSinceFullRefresh++;
    }

    // One-shot reset of the overlay rect so it doesn't leak into the
    // next frame. Callers must re-set it each frame the overlay is
    // dirty (display_set_overlay_rect + display_mark_dirty(Overlay,…)).
    _zones[(int)Zone::Overlay].x = 0;
    _zones[(int)Zone::Overlay].y = 0;
    _zones[(int)Zone::Overlay].w = 0;
    _zones[(int)Zone::Overlay].h = 0;
}

int display_text_width(const char* text) {
    if (!text || !*text) return 0;
    int w = 0;
    const uint8_t* p = (const uint8_t*)text;
    uint32_t cp;
    while ((cp = next_codepoint(&p)) != 0) {
        GFXglyph* glyph = nullptr;
        get_glyph(_font, cp, &glyph);
        if (glyph) w += glyph->advance_x;
    }
    return w;
}

int display_font_height() {
    return _font->advance_y;
}

int display_font_ascender() {
    return _font->ascender;
}

int display_width() {
    return PORTRAIT_W;
}

int display_height() {
    return PORTRAIT_H;
}

void display_set_font_size(int sizeLevel) {
    // UI font selector — chrome (header, footer, menus, library list,
    // settings) always renders in Inter regardless of the reader-family
    // setting.  Reader text uses display_set_font(level, family) instead.
    // Intentionally silent (no Serial log): UI font switches happen on
    // every screen transition and would flood the log; reader changes
    // are user-initiated and still logged by display_set_font().
    if (sizeLevel < 0) sizeLevel = 0;
    if (sizeLevel >= FONT_SIZE_LEVEL_COUNT) sizeLevel = FONT_SIZE_LEVEL_COUNT - 1;
    const GFXfont* newFont = _ui_fonts[sizeLevel];
    if (newFont != _font) {
        _font = newFont;
        glyph_cache_init();
    }
}

void display_set_font(int sizeLevel, uint8_t family) {
    if (sizeLevel < 0) sizeLevel = 0;
    if (sizeLevel >= FONT_SIZE_LEVEL_COUNT) sizeLevel = FONT_SIZE_LEVEL_COUNT - 1;
    // Settings storage is uint8_t; clamp before indexing the lookup table
    // to keep an out-of-range value from causing UB on the next paginate.
    if (family >= FONT_FAMILY_COUNT) family = FONT_FAMILY_SANS;
    const GFXfont* newFont = _font_table[family][sizeLevel];
    if (newFont != _font) {
        _font = newFont;
        glyph_cache_init();  // invalidate cache on font change
    }
    Serial.printf("Font set to %s level %d (advance_y=%d)\n",
                  kFontFamilyNames[family], sizeLevel, _font->advance_y);
}

void display_power_off() {
    epd_be_poweroff_all();  // zero all control bits for full TPS65185 standby
}
